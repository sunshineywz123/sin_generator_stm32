//-----------------------------------------------------------------
// 程序描述:
//    波形参数设置程序
// 作    者: 凌智电子
// 开始日期: 2014-01-17
// 完成日期: 2014-01-18
// 修改日期:
// 版    本: V1.0
//   - V1.0:
// 调试工具: 凌智STM32+FPGA电子系统设计开发板、LZE_ST LINK2
// 说    明:
//    - 调试使用的系统时钟频率Fsysclk=72MHz；
//-----------------------------------------------------------------

//-----------------------------------------------------------------
// 头文件包含
//-----------------------------------------------------------------
#include <stm32f10x.h>
#include "Wave.h"
#include "key_4_4.h"
#include "SPFD5408.h"
//-----------------------------------------------------------------
// 全局变量
//-----------------------------------------------------------------

u8 Num_mode=5;															// 波形模式
//-----------------------------------------------------------------
// 功能程序区
//-----------------------------------------------------------------
//-----------------------------------------------------------------
// u32 Key_ldate(void)
//-----------------------------------------------------------------
//
// 函数功能: 数字发送模块
// 入口参数: 无
// 返 回 值: 返回设置值
// 注意事项: 目前只发送整数
//-----------------------------------------------------------------
extern u32 Key_ldate(void)	
{	
	u32 Key_num[8],j=0,i=0,k=0;
	u32 num;
	u8 Debug_flag=0;
	u32 Return_date=0;  											//按键处理后的值
	u32 Pow_date=1;

	Debug_flag=1;  														//进入调试
	LCD_WriteString(100,80+Num_mode*30,RED,WHITE,"          ");
	j=0;
	while(Debug_flag == 1)										//频率数字输入
	{
		num = KeyTransfer();
		if((Num_mode==0) && (num!=12) && (num<10))
		{
			switch(num)                         
			{ 
				// 波形模式显示
			  case  1:  LCD_WriteString(110,80,RED,WHITE,"正弦波");break;
				case  2:  LCD_WriteString(110,80,RED,WHITE,"  AM  ");break;
			  case  3:  LCD_WriteString(110,80,RED,WHITE,"  FM  ");break;
				case  4:  LCD_WriteString(110,80,RED,WHITE,"  ASK ");break;
				case  5:  LCD_WriteString(110,80,RED,WHITE,"  PSK ");break;
				default:  break;
			 }
			 Key_num[0] = num;
			 j=1;
	  } 
		else if(num<10 | num==13)
		{
			if(j<8 && num!=13)                     // 按下系统板的‘-’键
			{
				Key_num[j]=num; 										// j的值为0~7
				LCD_WriteASCII(8*j+100,80+Num_mode*30,RED,WHITE,Key_num[j]+'0');	
				j=j+1;			
			}
			else if(num==13 && j>0) 							// 按错按键时,进行退位操作
			{
				j=j-1;
				LCD_WriteASCII(8*j+100,80+Num_mode*30,RED,WHITE,' ');
			}
		}
		else if(num == 12)											// 按下系统板的‘+’键
		{	
			Debug_flag=0;													// 退出调试
			i=j;						
		}			
	}
	while(i)			 														
	{
		// 将存在Key_num中的元素拼成一个整数
		for(k=0;k<j-i;k++)								
		{
			Pow_date = Pow_date*10;
		}
		Return_date = Return_date+Key_num[i-1]*Pow_date;
		Pow_date = 1;
		i--;
	}
	return Return_date;
}

//-----------------------------------------------------------------
// End Of File
//-----------------------------------------------------------------
