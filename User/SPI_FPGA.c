//-----------------------------------------------------------------
// 程序描述:
//		MCU与FPGA之间的SPI通信驱动程序
// 作    者: 凌智电子
// 开始日期: 2014-02-15
// 完成日期: 2014-02-15
// 修改日期: 2014-02-17
// 历史版本：V1.0
// 当前版本：V1.1
//   - V1.1：修改格式
// 调试工具: 凌智STM32+FPGA电子系统设计开发板、LZE_ST LINK2
// 说    明:
//    - 调试使用的系统时钟频率Fsysclk=72MHz；
//		-	改用6条线的通信方式
//		-	发送和接收都采用高位在前,低位在后
//-----------------------------------------------------------------

//-----------------------------------------------------------------
// 头文件包含
//-----------------------------------------------------------------
#include <stm32f10x.h>
#include "SPI_FPGA.h"

//-----------------------------------------------------------------
// 初始化程序区
//-----------------------------------------------------------------
//-----------------------------------------------------------------
// void GPIO_SPI_FPGA_Configuration(void)
//-----------------------------------------------------------------
//
// 函数功能: SPI通信IO初始化程序
// 入口参数: 无
// 返 回 值: 无
// 注意事项: 引脚连接如下：
//		SPI_SEL				PB.11				
//		SPI_CS			  PB.12
//		SPI_SCK				PB.13
//		SPI_MISO			PB.14
//		SPI_MOSI			PB.15
//-----------------------------------------------------------------
void GPIO_SPI_FPGA_Configuration(void)
{
	GPIO_InitTypeDef GPIO_InitStructure;
	
	RCC_APB2PeriphClockCmd(RCC_APB2Periph_GPIOB, ENABLE);
	
	GPIO_InitStructure.GPIO_Pin =  GPIO_Pin_12|GPIO_Pin_13|GPIO_Pin_14|GPIO_Pin_15;
  GPIO_InitStructure.GPIO_Mode = GPIO_Mode_Out_PP;		 			// 推挽输出
  GPIO_InitStructure.GPIO_Speed = GPIO_Speed_50MHz;
  GPIO_Init(GPIOB, &GPIO_InitStructure);
	
	GPIO_InitStructure.GPIO_Pin =  GPIO_Pin_11;
  GPIO_InitStructure.GPIO_Mode = GPIO_Mode_IPU;		 					// 上拉输入
  GPIO_Init(GPIOB, &GPIO_InitStructure);	
}

//-----------------------------------------------------------------
// SPI_FPGA_Init(void)
//-----------------------------------------------------------------
//
// 函数功能: SPI初始化
// 入口参数: 无
// 返 回 值: 无
// 注意事项: 在程序一开始的时候,片选拉高
//-----------------------------------------------------------------
extern void SPI_FPGA_Init(void)
{
	GPIO_SPI_FPGA_Configuration();						// SPI通信IO初始化
	SPI_FPGA_SCL_Set;													// 开始就拉个时钟线
	SPI_FPGA_MOSI_Set;
	CS_CMD_Set;
	CS_DATA_Set;
}

//-----------------------------------------------------------------
// 功能程序区
//-----------------------------------------------------------------

//-----------------------------------------------------------------
// void spi_send_cmd(u8 send_data)
//-----------------------------------------------------------------
//
// 函数功能: 发送8位的命令(默认)
// 入口参数: 要发送的命令
// 返 回 值: 无
// 注意事项: 时钟是上升沿的时候发送命令片选低电平有效有效
//-----------------------------------------------------------------
void spi_send_cmd(u8 send_data)
{	
	u8	i;
	
	CS_CMD_Clr;																	// 片选选中
	for(i=0;i<SPI_CMD_WIDTH;i++)
	{		
		if((send_data&0x80) == 0x80) 
		{
			SPI_FPGA_MOSI_Set;
		}
		else 
		{
			SPI_FPGA_MOSI_Clr;
		}				
		send_data = send_data<<1;									// 高位在前
		SPI_FPGA_SCL_Clr;
		SPI_FPGA_SCL_Set;													// 上升沿发送数据
	}
	CS_CMD_Set;																	// 片选拉高
}

//-----------------------------------------------------------------
// void spi_send_data(u32 send_data)
//-----------------------------------------------------------------
//
// 函数功能: spi发送数据
// 入口参数: 待发的数据
// 返 回 值: 无
// 注意事项: 时钟是上升沿的时候发送数据,片选低电平有效有效
//					 数据类型是32位无符号长整形,数据类型可以根据需要更改      
//-----------------------------------------------------------------
void spi_send_data(u32 send_data)
{	
	u8	i;
	
	CS_DATA_Clr;															// 片选选中
	for(i=0;i<SPI_DATA_WIDTH;i++)
	{ 
		if((send_data&0x80000000) == 0x80000000)
		{
			SPI_FPGA_MOSI_Set;
		}
		else
		{
			SPI_FPGA_MOSI_Clr;
		}				
		send_data=send_data<<1;									// 高位在前
		SPI_FPGA_SCL_Clr;
		SPI_FPGA_SCL_Set;												// 上升沿发送数据
	}
	CS_DATA_Set;															// 片选拉高
}

//-----------------------------------------------------------------
// u32	spi_rece_data(void)
//-----------------------------------------------------------------
//
// 函数功能: spi接收数据---数据类型是32位无符号长整形,数据类型
// 入口参数: 无
// 返 回 值: 接收到的数据
// 注意事项: 时钟是下降接收数据,片选下降沿有效
//-----------------------------------------------------------------
u32	spi_rece_data(void)
{
	u8	i;
	u32 data_bufe=0;													// 接收到得数据
	
	CS_DATA_Clr;															// 片选选中
	for(i=0;i<SPI_DATA_WIDTH;i++)
	{
		SPI_FPGA_SCL_Set;	
		SPI_FPGA_SCL_Clr;												// 下降沿接收数据	
		
		data_bufe<<=1;													// 左移	
		data_bufe=data_bufe | SPI_FPGA_MISO;		// 接收数据
	}
	CS_DATA_Set;															// 片选拉高
	return data_bufe;
}

//-----------------------------------------------------------------
// void spi_send_cmd_data(u8 cmd,u32 send_data)
//-----------------------------------------------------------------
//
// 函数功能: 先发送命令,在发送数据
// 入口参数: 要发送的命令,要发送的数据
// 返 回 值: 无
// 注意事项: 先发送地址，再发送数据
//-----------------------------------------------------------------
extern void spi_send_cmd_data(u8 cmd,u32 send_data)
{
	spi_send_cmd(cmd);												// 发送地址
	spi_send_data(send_data);									// 发送数据
}

//-----------------------------------------------------------------
// u32	spi_rece_cmd_data(u8 cmd)
//-----------------------------------------------------------------
//
// 函数功能: 先发送命令,在接收数据
// 入口参数: 要发送的命令
// 返 回 值: 接收到的数据
// 注意事项: 
//-----------------------------------------------------------------
extern u32	spi_rece_cmd_data(u8 cmd)
{
	spi_send_cmd(cmd);												// 发送地址
	return(spi_rece_data());									// 指定地址读取数据
}

//-----------------------------------------------------------------
// End Of File
//-----------------------------------------------------------------
